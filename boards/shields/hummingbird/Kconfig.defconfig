## boards/shields/hummingbird/Kconfig.defconfig
```kconfig
if SHIELD_HUMMINGBIRD_LEFT

config ZMK_KEYBOARD_NAME
    default "hummingbird"

config ZMK_SPLIT_ROLE_CENTRAL
    default y

endif

if SHIELD_HUMMINGBIRD_LEFT || SHIELD_HUMMINGBIRD_RIGHT

config ZMK_SPLIT
    default y

endif
```
